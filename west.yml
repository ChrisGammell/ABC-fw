## west.yml
```yaml
manifest:
  remotes:
    - name: zephyrproject-rtos
      url-base: https://github.com/bwasim
    - name: ABC-fw
      url-base: https://github.com/ChrisGammell
  defaults:
    remote: ABC-fw
  projects:
    - name: zephyr
      remote: zephyrproject-rtos
      revision: ble-cell
      import: true
  self:
    path: abc_fw
```
